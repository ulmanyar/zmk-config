## config/boards/shields/pedal/Kconfig.defconfig
```kconfig
# Copyright (c) 2022 The ZMK Contributors
# SPDX-License-Identifier: MIT

if SHIELD_PEDAL

config ZMK_KEYBOARD_NAME
    default "pedal"

endif
```

## config/boards/shields/splaytoraid40/boards/sparkfun_pro_micro_rp2040.conf
```kconfig
CONFIG_CONSOLE=n
CONFIG_SERIAL=n
CONFIG_UART_CONSOLE=n
CONFIG_ZMK_USB=y
CONFIG_PINCTRL=y

# For mouse
CONFIG_SPI=y
CONFIG_I2C=y
# Enable Trackpad
CONFIG_INPUT=y
CONFIG_ZMK_MOUSE=y
CONFIG_INPUT_PINNACLE=y
```

## config/west.yml
```yaml
manifest:
  remotes:
    - name: zmkfirmware
      url-base: https://github.com/zmkfirmware
    - name: nickconway
      #Use branch smart-interrupt
      url-base: https://github.com/nickconway
    - name: caksoylar
      #Use branch caksoylar/experimental
      url-base: https://github.com/caksoylar
    - name: ulmanyar
      url-base: https://github.com/ulmanyar
  projects:
    - name: zmk
      remote: caksoylar
      revision: caksoylar/experimental
      import: app/west.yml
  self:
    path: config
```
